## CMakeLists.txt
```
# EHG board firmware: plays a stored EHG recording and sends it over Bluetooth.
#
# PURPOSE: Tells the build tool which C files make up the firmware.
# INPUT: src/*.c + their .h files, prj.conf, Kconfig, boards/nrf52840dk_nrf52840.overlay;
#   built-in mode only: src/replay_data.h (tools/make_replay.py).
#   e.g. src/main.c, src/replay.c, src/ehg_service.c
# OUTPUT: the firmware image in build/ (flashed onto the nRF52840 DK).
#   e.g. build/ehg_node/zephyr/zephyr.signed.hex (Intel-HEX text, lines like ":10000000..."), started by MCUboot
#        last build (2026-10-20, with MCUboot): app 167336 B (35 % of its 464 KB slot), RAM 181000 B (69 %)
# HOW: Loads Zephyr (the board's small operating system), lists the C files. By default the recording
#   is not built in (tools/feed.py streams it over serial); with CONFIG_EHG_BAKED_RECORD (build.sh --record)
#   src/replay_data.h is compiled into replay.c and must exist.
# BEFORE -> AFTER: Run by firmware/build.sh, together with prj.conf (settings) and Kconfig (our settings).
# SEE: docs/firmware.md
cmake_minimum_required(VERSION 3.20.0)
find_package(Zephyr REQUIRED HINTS $ENV{ZEPHYR_BASE})
project(ehg_node)

if(CONFIG_EHG_BAKED_RECORD AND NOT EXISTS ${CMAKE_CURRENT_SOURCE_DIR}/src/replay_data.h)
  message(FATAL_ERROR "built-in record mode needs src/replay_data.h: build with firmware/build.sh --record <npz>")
endif()

target_sources(app PRIVATE src/main.c src/replay.c src/ehg_service.c)
```

## Kconfig
```
# PURPOSE: Our own build settings (with defaults), next to Zephyr's.
# HOW: Each "config" becomes a CONFIG_EHG_* constant in the C code. Change a value in prj.conf.
# ROLE IN THESIS: The experiment knobs: latency vs efficiency (H1), how much loss can be recovered (H2).
# BEFORE -> AFTER: Read at build time. Used in replay.c (queue sizes) and ehg_service.c
#   (frames per packet, history size).
source "Kconfig.zephyr"

menu "EHG node"

config EHG_FRAMES_PER_PACKET
	int "Frames batched into one BLE notification"
	default 10
	help
	  More frames per packet = fewer, bigger packets, but more waiting (report 6.8, [16]).
	  At 20 Hz, 10 frames = 0.5 s wait. 20-byte header + samples must fit 244 bytes.

config EHG_RING_FRAMES
	int "Ring buffer capacity between injection and packetiser (frames)"
	default 256
	help
	  How many frames can wait if sending falls behind (256 = 12.8 s at 20 Hz).
	  When full, new frames are dropped and counted as ring_overflow (replay.c).

config EHG_BAKED_RECORD
	bool "Built-in recording instead of the serial feed"
	help
	  y = the recording in src/replay_data.h (tools/make_replay.py) is compiled in and played on
	  START, so the board runs stand-alone. n (default) = tools/feed.py streams it over serial.
	  Set by firmware/build.sh: --record <npz> gives y, otherwise n.

config EHG_FEED_BUFFER_FRAMES
	int "Frames the laptop can send ahead (tools/feed.py)"
	default 512
	help
	  Queue between the serial parser and the replay timer (replay.c). tools/feed.py keeps
	  about 2 s queued, so this must hold 2 s at the highest rate: 400 frames at 200 Hz.
	  64 B of RAM per frame (16 channels x int32 + frame number).

config EHG_HISTORY_PACKETS
	int "Sent packets kept for gateway re-requests"
	default 256
	help
	  How far back a lost packet can still be re-sent (256 x 10 frames = 128 s at 20 Hz).
	  Older requests can't be served; counted as resend_miss (ehg_service.c).

config EHG_REQUIRE_PAIRING
	bool "Require LESC passkey pairing before the EHG service can be used"
	default n
	help
	  n (default) = open link, behaviour unchanged. y = the data CCC, the command slot and the
	  MCUmgr (OTA) service need an AUTHENTICATED, encrypted link (LE Secure Connections with a
	  passkey the board prints on the UART log). Set by the security.conf overlay
	  (firmware/build.sh --secure), which also turns on the Bluetooth security options this needs.

config EHG_PAIRING_BUTTON
	bool "Pair only while Button 2 has been pressed (Just Works), instead of a passkey from the UART log"
	depends on EHG_REQUIRE_PAIRING
	default n
	help
	  y = no passkey. The link must be ENCRYPTED (LE Secure Connections, Just Works), and the board accepts a
	  NEW pairing only for CONFIG_EHG_PAIRING_WINDOW_S seconds after Button 2 is pressed (LED3 lit); it then also
	  asks a connected central to pair. A central that is already bonded reconnects without the button.
	  Protects against passive listening and against anyone who is not at the board; it does NOT stop an active
	  man-in-the-middle during the window (Just Works has no code to compare). Set by security-button.conf
	  (firmware/build.sh --pairing-button).

config EHG_PAIRING_WINDOW_S
	int "Seconds a Button 2 press keeps pairing open"
	depends on EHG_PAIRING_BUTTON
	default 60

endmenu
```

## sysbuild.conf
```
# Sysbuild settings: what gets built next to our app.
# MCUboot = a small bootloader at the start of flash. It keeps 2 slots for the app, so a new firmware
# can be uploaded over Bluetooth (MCUmgr/SMP, prj.conf) into the spare slot, tested, then confirmed;
# a bad update falls back to the old one. Uses MCUboot's public development key: fine for a thesis
# rig, not for a real device (that needs its own signing key, SB_CONFIG_BOOT_SIGNATURE_KEY_FILE).
SB_CONFIG_BOOTLOADER_MCUBOOT=y
```

## prj.conf
```kconfig
# PURPOSE: Turns on, and sizes, the Zephyr + Bluetooth features the firmware uses.
# HOW: 1 setting per line (CONFIG_X=value), fixed at build time.
# ROLE IN THESIS: Sets radio packet size + buffering: limits speed and latency (H1), and makes a
#   slow link wait instead of losing data (H2).
# BEFORE -> AFTER: Read by firmware/build.sh. Affects main.c and ehg_service.c.
# SEE: docs/firmware.md, docs/research/nrf-ble-environment.md (sources for each value).

# ---- serial port (J-Link VCOM0, 460800 baud: boards/nrf52840dk_nrf52840.overlay), shared by
# the log (board -> laptop) and the sample stream from tools/feed.py (laptop -> board, replay.c)
CONFIG_LOG=y
# no colour codes: tools/feed.py reads these lines
CONFIG_LOG_BACKEND_SHOW_COLOR=n
# write each log line out at once: the default batches lines for up to 1 s, so tools/feed.py got
# its once-a-second @LVL reports in late pairs and let the queue run dry (2026-10-20)
CONFIG_LOG_PROCESS_TRIGGER_THRESHOLD=1
# receive by DMA (no byte lost while the radio is busy); the log still writes with poll_out
CONFIG_UART_ASYNC_API=y
CONFIG_RING_BUFFER=y
# CRC-16 on BLE packets (ehg_packet.h), serial messages and "@" lines
CONFIG_CRC=y
# HWINFO = read the chip ID for the name
CONFIG_HWINFO=y
# DK buttons + LEDs (Nordic's library): Button 1 = start/stop, LED1 = connected, LED2 = sampling
CONFIG_DK_LIBRARY=y

# ---- Bluetooth: the board is the "peripheral" (waits to be connected), 1 connection at a time
CONFIG_BT=y
CONFIG_BT_PERIPHERAL=y
CONFIG_BT_MAX_CONN=1
CONFIG_BT_DEVICE_NAME_DYNAMIC=y
CONFIG_BT_DEVICE_NAME="EHG-0000"

# Biggest message sizes: up to 244 bytes of packet per Bluetooth message.
# (MTU 247 = message size; 251 = radio packet size. ehg_service.c won't build if a packet is bigger.)
CONFIG_BT_L2CAP_TX_MTU=247
CONFIG_BT_BUF_ACL_RX_SIZE=251
CONFIG_BT_BUF_ACL_TX_SIZE=251
CONFIG_BT_CTLR_DATA_LENGTH_MAX=251
CONFIG_BT_USER_PHY_UPDATE=y
CONFIG_BT_USER_DATA_LEN_UPDATE=y

# Send buffers: when all 10 are busy, sending waits (data backs up, isn't lost)
CONFIG_BT_BUF_ACL_TX_COUNT=10
CONFIG_BT_ATT_TX_COUNT=10
CONFIG_BT_L2CAP_TX_BUF_COUNT=10
# radio-side send buffers, same count as above (else a warning at start-up)
CONFIG_BT_CTLR_SDC_TX_PACKET_COUNT=10
# must be more than the send-buffer count (build check)
CONFIG_BT_BUF_EVT_RX_COUNT=11

# How often board and laptop talk: every 15-30 ms (units of 1.25 ms: 12 = 15 ms, 24 = 30 ms).
# Link counts as lost after 6 s of silence (600 x 10 ms). Values follow Apple's accessory rules (macOS laptop).
CONFIG_BT_PERIPHERAL_PREF_MIN_INT=12
CONFIG_BT_PERIPHERAL_PREF_MAX_INT=24
CONFIG_BT_PERIPHERAL_PREF_LATENCY=0
CONFIG_BT_PERIPHERAL_PREF_TIMEOUT=600

CONFIG_MAIN_STACK_SIZE=2048

# ---- firmware update over Bluetooth (MCUboot from sysbuild.conf + MCUmgr/SMP service).
# Upload with Nordic's "nRF Device Manager" phone app: build/dfu_application.zip (docs/firmware.md).
CONFIG_NCS_SAMPLE_MCUMGR_BT_OTA_DFU=y
# MCUmgr's command handlers run on the system workqueue and need a bigger stack (Nordic smp_svr sample)
CONFIG_SYSTEM_WORKQUEUE_STACK_SIZE=2304
```

## security-button.conf
```kconfig
# PURPOSE: Overlay for the "button pairing" build (firmware/build.sh --pairing-button): an ENCRYPTED link, and new pairings only for 60 s after Button 2.
#   For boards nobody can read a UART log from. Alternative to security.conf (do not use both): no passkey, so Just Works.
# HOW: Merged over prj.conf by -Dehg_node_EXTRA_CONF_FILE. Protects against passive listening and against anyone who is not at the board;
#   it does NOT stop an active man-in-the-middle inside the window. See docs/security.md and docs/decisions.
CONFIG_EHG_REQUIRE_PAIRING=y
CONFIG_EHG_PAIRING_BUTTON=y
CONFIG_BT_SMP=y
# LESC only (no legacy pairing, which can be sniffed): BT_SMP_SC_PAIR_ONLY. NOT BT_SMP_SC_ONLY: that is "Secure Connections Only Mode", security level 4 =
# authenticated pairing, which rejects Just Works (first phone test: pairing failed, reason 4; bt_conn_set_security returned -EINVAL).
CONFIG_BT_SMP_SC_PAIR_ONLY=y
# No passkey exists, so MITM is not requested; the Kconfig default is y, so say n.
CONFIG_BT_SMP_ENFORCE_MITM=n
# main.c decides, per pairing request, whether the Button 2 window is open
CONFIG_BT_SMP_APP_PAIRING_ACCEPT=y
CONFIG_BT_BONDABLE=y
# the default is 1: a Mac bond left in flash would then block the phone. Room for the phone, the Mac and a spare.
CONFIG_BT_MAX_PAIRED=4
CONFIG_BT_SETTINGS=y
CONFIG_SETTINGS=y
CONFIG_FLASH=y
CONFIG_FLASH_MAP=y
CONFIG_NVS=y
# the MCUmgr (OTA) service needs the encrypted link too (default would be open read/write)
CONFIG_MCUMGR_TRANSPORT_BT_PERM_RW_ENCRYPT=y
```

## security.conf
```kconfig
# PURPOSE: Overlay for the "secure" build (firmware/build.sh --secure): the link needs LE Secure Connections passkey pairing.
# HOW: Merged over prj.conf by -Dehg_node_EXTRA_CONF_FILE. The default build does not read this file and is unchanged.
# SEE: docs/security.md (BLE pairing), docs/troubleshooting.md (stale bonds).
CONFIG_EHG_REQUIRE_PAIRING=y
CONFIG_BT_SMP=y
# LESC only (no legacy pairing, which can be sniffed); this makes security level 4 the only way in
CONFIG_BT_SMP_SC_ONLY=y
# a passkey is mandatory (no Just Works)
CONFIG_BT_SMP_ENFORCE_MITM=y
CONFIG_BT_BONDABLE=y
# bonds survive a reset: stored in the flash "storage" partition (0xf8000, 32 KB, outside both app slots)
CONFIG_BT_SETTINGS=y
CONFIG_SETTINGS=y
CONFIG_FLASH=y
CONFIG_FLASH_MAP=y
# without a storage backend CONFIG_SETTINGS silently becomes SETTINGS_NONE and no bond is ever saved (seen on the first secure build)
CONFIG_NVS=y
# the MCUmgr (OTA) service too: Nordic's OTA helper (nrf/samples/common/mcumgr_bt_ota_dfu) defaults it to open read/write, which would leave
# firmware upload unauthenticated in the one build that is meant to be secure
CONFIG_MCUMGR_TRANSPORT_BT_PERM_RW_AUTHEN=y
```

## boards/nrf52840dk_nrf52840.overlay
```dts
/* Serial port for the J-Link VCOM, shared by the log and the sample stream (tools/feed.py).
 * 460800, not 1000000: at 1 Mbaud the VCOM lost board->laptop bytes (Unit 0 check, 2026-10-20).
 * hw-flow-control: the board's RTS line (P0.05, wired to the J-Link chip on the DK) tells the J-Link
 * to pause when the board can't take bytes, instead of the UART overflowing. Without it, ~1 serial
 * message a minute was cut short ("line errors") while Bluetooth was busy (2026-10-20).
 * Zephyr applies this file automatically when building for nrf52840dk/nrf52840. */
&uart0 {
	current-speed = <460800>;
	hw-flow-control;
};
```

## src/main.c
```c
/*
 * main.c - start-up + Bluetooth connection. The program starts here.
 *
 * PURPOSE: Names the board, makes it findable over Bluetooth, accepts the laptop's connection,
 *   prints link info + counters to the serial log.
 * INPUT: chip ID (for the name); the connection from the laptop (gateway/gateway.py).
 *   e.g. chip ID 8 bytes, last 2 = 93 C0 (our DK) -> name "EHG-93C0".
 *   e.g. connection: the laptop connects and asks for its link settings; main.c only accepts.
 * OUTPUT: Bluetooth adverts as "EHG-XXXX" (XXXX from the chip ID, so every board has its own name, H3).
 *   Serial log (VCOM0, 460800 baud): link settings when they change, packet counters every 10 s.
 *   e.g. advert: flags 06 + name "EHG-93C0"; scan response: service ID 4e480001-a0e1-...-9a1b2c3d4e5f
 *   e.g. log of 1 connection (timestamps vary; values from the 2026-10-06 run):
 *     [00:00:00.010,000] <inf> main: advertising as EHG-93C0
 *     [00:00:04.120,000] <inf> main: connected
 *     [00:00:04.300,000] <inf> main: PHY: tx 2 rx 2 (1=1M 2=2M)
 *     [00:00:04.350,000] <inf> main: data length: tx 251 B rx 251 B
 *     [00:00:04.400,000] <inf> main: ATT MTU: tx 247 rx 247
 *     [00:00:04.900,000] <inf> main: conn params: interval 30.00 ms, latency 0, timeout 6000 ms
 *     [00:00:10.000,000] <inf> ehg_svc: sent=11 resent=0 resend_miss=0 notify_err=0 ring_overflow=0 max_inject_late=31 us
 *     [00:05:00.000,000] <inf> main: disconnected (0x13)   (0x13 = laptop closed it; 0x08 = link timed out)
 * HOW: name from chip ID -> Bluetooth on -> advertise ("I'm here, connect to me").
 *   Button 1 starts/stops a session (as the laptop's START/STOP does). LED1 = connected, LED2 = sampling.
 *   On connect: hand the connection to ehg_service.c, ask for the fastest radio settings.
 *   The laptop decides what it actually grants; the callbacks below only log it.
 *   Streaming starts later, when the laptop sends START.
 * ROLE IN THESIS: Board side of the Bluetooth link (report Fig. 10). Logged settings explain latency (H1).
 * SEE: ehg_service.c (data + commands), docs/firmware.md (overview + glossary).
  */
#include <stdio.h>
#include <zephyr/bluetooth/bluetooth.h>
#include <zephyr/bluetooth/conn.h>
#include <zephyr/bluetooth/gatt.h>
#include <zephyr/drivers/hwinfo.h>
#include <zephyr/kernel.h>
#include <zephyr/logging/log.h>
#ifdef CONFIG_EHG_REQUIRE_PAIRING
#include <zephyr/settings/settings.h>
#endif

#include <dk_buttons_and_leds.h>

#include "ehg_service.h"
#include "replay.h"

LOG_MODULE_REGISTER(main, LOG_LEVEL_INF);

/* What the board broadcasts so the laptop can find it.
 * ad = flags + name. sd ("scan response", sent when asked) = the EHG service ID the gateway looks for. */
static char name[9]; /* "EHG-XXXX" */
static struct bt_data ad[] = {
	BT_DATA_BYTES(BT_DATA_FLAGS, (BT_LE_AD_GENERAL | BT_LE_AD_NO_BREDR)),
	BT_DATA(BT_DATA_NAME_COMPLETE, name, 8),
};
static const struct bt_data sd[] = {
	BT_DATA_BYTES(BT_DATA_UUID128_ALL, EHG_SVC_UUID_VAL),
};

/* Start advertising. Queued as a job so it can be restarted after a disconnect. */
static void adv_work_handler(struct k_work *work)
{
	int err = bt_le_adv_start(BT_LE_ADV_CONN_FAST_2, ad, ARRAY_SIZE(ad), sd, ARRAY_SIZE(sd));

	if (err) {
		LOG_ERR("advertising failed (%d)", err);
	} else {
		LOG_INF("advertising as %s", name);
	}
}
static K_WORK_DEFINE(adv_work, adv_work_handler);

#ifdef CONFIG_EHG_PAIRING_BUTTON
static void pairing_on_connect(struct bt_conn *conn);
#else
#define pairing_on_connect(conn) ((void)0)
#endif

/* Laptop connected: hand the connection to ehg_service.c, ask for faster radio settings. */
static void connected(struct bt_conn *conn, uint8_t err)
{
	if (err) {
		LOG_WRN("connection failed (0x%02x)", err);
		return;
	}
	LOG_INF("connected");
	pairing_on_connect(conn);
	ehg_service_set_conn(conn);
	/* Only requests: the laptop decides. 2M PHY = 2 Mbit/s radio mode; data length = bigger radio packets. */
	bt_conn_le_phy_update(conn, BT_CONN_LE_PHY_PARAM_2M);
	bt_conn_le_data_len_update(conn, BT_LE_DATA_LEN_PARAM_MAX);
}

/* Connection lost: forget it and print the counters. Sampling carries on (like a real sensor):
 * packets made while offline wait in history and are re-sent when the gateway asks after reconnecting. */
static void disconnected(struct bt_conn *conn, uint8_t reason)
{
	LOG_INF("disconnected (0x%02x)", reason);
	ehg_service_set_conn(NULL);
	ehg_service_log_stats();
}

/* Connection fully cleaned up: advertise again so the gateway can reconnect. */
static void recycled(void)
{
	k_work_submit(&adv_work);
}

/* These 3 only log what the laptop granted. Units: interval x 1.25 ms, timeout x 10 ms. */
static void param_updated(struct bt_conn *conn, uint16_t interval, uint16_t latency, uint16_t timeout)
{
	LOG_INF("conn params: interval %u.%02u ms, latency %u, timeout %u ms", interval * 125 / 100,
		(interval * 125) % 100, latency, timeout * 10);
}

static void phy_updated(struct bt_conn *conn, struct bt_conn_le_phy_info *p)
{
	LOG_INF("PHY: tx %u rx %u (1=1M 2=2M)", p->tx_phy, p->rx_phy);
}

static void data_len_updated(struct bt_conn *conn, struct bt_conn_le_data_len_info *i)
{
	LOG_INF("data length: tx %u B rx %u B", i->tx_max_len, i->rx_max_len);
}

/* Tell the Bluetooth stack to call the functions above on these events. */
BT_CONN_CB_DEFINE(conn_cb) = {
	.connected = connected,
	.disconnected = disconnected,
	.recycled = recycled,
	.le_param_updated = param_updated,
	.le_phy_updated = phy_updated,
	.le_data_len_updated = data_len_updated,
};

#ifdef CONFIG_EHG_REQUIRE_PAIRING
/* Pairing (security.conf build only). The board can only DISPLAY a passkey (no keyboard, no yes/no button), so the
 * laptop or phone types it in its own system dialog. The host makes a fresh random 6-digit passkey for every pairing.
 * The board never asks for security itself: the central starts pairing when its first protected access is refused. */
#ifndef CONFIG_EHG_PAIRING_BUTTON
static void passkey_display(struct bt_conn *conn, unsigned int passkey)
{
	LOG_INF("PASSKEY %06u (type this in the pairing dialog)", passkey);
}
#endif

static void pairing_cancel(struct bt_conn *conn)
{
	LOG_WRN("pairing cancelled");
}

#ifdef CONFIG_EHG_PAIRING_BUTTON
/* Button pairing (security-button.conf build). Button 2 opens a window; a NEW pairing is accepted only inside it, and
 * the board then asks the central to pair (an SMP security request), because iOS did not start pairing by itself on a refused access.
 * No passkey: IO capability NoInputNoOutput, so the pairing is LE Secure Connections Just Works (encrypted, not authenticated). */
static int64_t window_end_ms;

static bool pairing_window_open(void)
{
	return k_uptime_get() < window_end_ms;
}

static enum bt_security_err pairing_accept(struct bt_conn *conn, const struct bt_conn_pairing_feat *const feat)
{
	if (!pairing_window_open()) {
		LOG_WRN("pairing refused: press Button 2 first");
		return BT_SECURITY_ERR_PAIR_NOT_ALLOWED;
	}
	return BT_SECURITY_ERR_SUCCESS;
}

static void ask_to_pair(struct bt_conn *conn, void *data)
{
	if (bt_conn_get_security(conn) < BT_SECURITY_L2) {
		LOG_INF("asking the central to pair (%d)", bt_conn_set_security(conn, BT_SECURITY_L2));
	}
}

static void pairing_on_connect(struct bt_conn *conn)
{
	if (pairing_window_open()) {
		ask_to_pair(conn, NULL);
	}
}

static void open_pairing_window(void)
{
	window_end_ms = k_uptime_get() + CONFIG_EHG_PAIRING_WINDOW_S * 1000LL;
	LOG_INF("pairing OPEN for %d s", CONFIG_EHG_PAIRING_WINDOW_S);
	bt_conn_foreach(BT_CONN_TYPE_LE, ask_to_pair, NULL);
}

static const struct bt_conn_auth_cb auth_cb = {.pairing_accept = pairing_accept, .cancel = pairing_cancel};
#else
static const struct bt_conn_auth_cb auth_cb = {.passkey_display = passkey_display, .cancel = pairing_cancel};
#endif

static void pairing_complete(struct bt_conn *conn, bool bonded)
{
	LOG_INF("pairing complete (bonded: %s)", bonded ? "yes" : "no");
#ifdef CONFIG_EHG_PAIRING_BUTTON
	window_end_ms = 0; /* one new pairing per Button 2 press */
#endif
}

static void pairing_failed(struct bt_conn *conn, enum bt_security_err reason)
{
	LOG_WRN("pairing failed (reason %d)", reason);
}

static void security_changed(struct bt_conn *conn, bt_security_t level, enum bt_security_err err)
{
	LOG_INF("security level %d (err %d)", level, err);
}

static struct bt_conn_auth_info_cb auth_info_cb = {.pairing_complete = pairing_complete, .pairing_failed = pairing_failed};
BT_CONN_CB_DEFINE(security_cb) = {.security_changed = security_changed};
#endif

/* MTU = biggest message the link allows. Ours need up to 247 bytes (see prj.conf). */
static void mtu_updated(struct bt_conn *conn, uint16_t tx, uint16_t rx)
{
	LOG_INF("ATT MTU: tx %u rx %u", tx, rx);
}

static struct bt_gatt_cb gatt_cb = {.att_mtu_updated = mtu_updated};

/* Button 1 starts or stops a session, like the button on a Zio or Faros patch. The laptop's START
 * over Bluetooth does the same; a START while running is ignored, so the two never fight. */
static void button_changed(uint32_t state, uint32_t has_changed)
{
#ifdef CONFIG_EHG_PAIRING_BUTTON
	if (has_changed & state & DK_BTN2_MSK) {
		open_pairing_window();
	}
#endif
	if (has_changed & state & DK_BTN1_MSK) {
		if (replay_running()) {
			LOG_INF("button: stop");
			replay_stop();
		} else {
			LOG_INF("button: start");
			replay_start();
		}
	}
}

/* Start here: name from the last 2 bytes of the chip ID, Bluetooth on, advertise, then show the
 * state on the LEDs (LED1 = laptop connected, LED2 = sampling) and print counters every 10 s.
 * The real work runs in other threads (replay.c, ehg_service.c). */
int main(void)
{
	uint8_t id[8] = {0};
	ssize_t n = hwinfo_get_device_id(id, sizeof(id));

	snprintf(name, sizeof(name), "EHG-%02X%02X", n >= 2 ? id[n - 2] : 0, n >= 1 ? id[n - 1] : 0);

	int err = bt_enable(NULL);

	if (err) {
		LOG_ERR("bt_enable failed (%d)", err);
		return 0;
	}
#ifdef CONFIG_EHG_REQUIRE_PAIRING
	if (bt_conn_auth_cb_register(&auth_cb) || bt_conn_auth_info_cb_register(&auth_info_cb)) {
		LOG_ERR("pairing callbacks not registered");
		return 0;
	}
	/* bonds (the keys of paired laptops) are kept in flash across resets. Right after bt_enable and BEFORE bt_set_name: the name and the GATT
	 * database hash are saved through the settings, which only work once they are loaded. */
	settings_load();
#ifdef CONFIG_EHG_PAIRING_BUTTON
	LOG_INF("pairing REQUIRED (encrypted link; new pairings only after Button 2, %d s)", CONFIG_EHG_PAIRING_WINDOW_S);
#else
	LOG_INF("pairing REQUIRED (LESC passkey)");
#endif
#endif
	bt_set_name(name);
	bt_gatt_cb_register(&gatt_cb);
	k_work_submit(&adv_work);
	if (dk_leds_init() || dk_buttons_init(button_changed)) {
		LOG_WRN("buttons/LEDs unavailable");
	}

	for (int i = 1;; i++) {
		k_sleep(K_MSEC(200));
		dk_set_led(DK_LED1, ehg_service_connected());
		dk_set_led(DK_LED2, replay_running());
#ifdef CONFIG_EHG_PAIRING_BUTTON
		dk_set_led(DK_LED3, pairing_window_open());
#endif
		if (i % 50 == 0) {
			ehg_service_log_stats();
		}
	}
	return 0;
}
```

## src/ehg_packet.h
```c
/*
 * ehg_packet.h - byte layout of 1 radio packet. Copy of gateway/packet.py: change both together.
 *
 * PURPOSE: So board and laptop agree on what every byte means.
 * LAYOUT: 20-byte header, then the samples, frame by frame.
 *   header = version, n_ch, fs_hz, seq, frame_idx, t_inject, n_frames, flags, record_id
 *     seq = packet number, t_inject = board clock tick when the packet's 1st frame was sampled
 *   samples = 2 bytes each (default), or 3 bytes when flags bit1 is set (24-bit option)
 *   then a 2-byte CRC-16 of everything before it (v2)
 *   e.g. 3 channels x 10 frames = 20 + 60 + 2 = 82 bytes (24-bit: 112)
 *   Numbers go low byte first ("little-endian"). Full table: docs/interface-spec.md 3.
 * ROLE IN THESIS: The contract the whole pipeline shares. seq -> losses countable (H2);
 *   t_inject -> latency measurable (H1); raw samples -> bit-for-bit comparison (H2/H4).
 * BEFORE -> AFTER: replay.c fills struct ehg_frame (1 instant of samples) -> ehg_service.c builds
 *   struct ehg_pkt_hdr + samples, sends over Bluetooth -> gateway/packet.py decodes it.
  */
#pragma once
#include <stdbool.h>
#include <stdint.h>
#include <zephyr/sys/util.h>
#include <zephyr/toolchain.h>

#define EHG_PKT_VERSION 2 /* v2 = v1 + CRC-16 trailer */
#define EHG_CRC_BYTES 2   /* CRC-16/CCITT-FALSE (crc16_itu_t, seed 0xFFFF) of all bytes before it, low byte first */
#define EHG_FLAG_RETRANS BIT(0)
#define EHG_FLAG_24BIT BIT(1) /* samples are 3 bytes each (the record is 24-bit, tools/feed.py CONFIG) */
#define EHG_MAX_PKT 244       /* MTU 247 - 3 bytes of ATT header */

/* Most channels any recording has (Icelandic ehgdb: 16). Sets the size of each queued frame. */
#define EHG_MAX_CH 16

/* The 20-byte header at the front of every packet. __packed = no hidden gap bytes. */
struct ehg_pkt_hdr {
	uint8_t version;
	uint8_t n_ch;
	uint16_t fs_hz;
	uint32_t seq;       /* packet number, from 0 at START */
	uint32_t frame_idx; /* frame number of the 1st frame, as numbered by tools/feed.py; recording row = frame_idx % length */
	uint32_t t_inject;  /* board clock (32768 ticks/s) when the 1st frame was released */
	uint8_t n_frames;
	uint8_t flags;
	uint16_t record_id; /* record_id in data/converted/<db>/manifest.json */
} __packed;

BUILD_ASSERT(sizeof(struct ehg_pkt_hdr) == 20, "wire header must be 20 bytes");

/* 1 frame (1 instant, all channels) on its way from replay.c to ehg_service.c. */
struct ehg_frame {
	uint32_t tick;
	uint32_t frame_idx;
	bool start; /* first frame of a session: ehg_service.c restarts seq and clears history */
	int32_t s[EHG_MAX_CH];
};

/* The 1-byte commands the laptop can send to the board. Sent by gateway/gateway.py,
 * handled in ehg_service.c:ctrl_write(). */
enum ehg_ctrl_op {
	EHG_OP_START = 0x01,  /* restart numbering, start the replay */
	EHG_OP_STOP = 0x02,   /* no args */
	EHG_OP_RESEND = 0x03, /* + 4-byte seq, 2-byte count: send these packets again */
};
```

## src/ehg_service.c
```c
/*
 * ehg_service.c - packs frames into numbered packets, sends them over Bluetooth, re-sends lost ones.
 *
 * PURPOSE: Frames -> numbered radio packets -> laptop. Re-sends any packet the laptop says it missed.
 * INPUT: frames from the queue replay_ring (replay.c).
 *   Commands the laptop (gateway/gateway.py) writes: 01 START, 02 STOP, 03 RESEND <seq> <count>.
 *   e.g. frame from the queue: {tick=98304, frame_idx=0, s={1093, 171, -748}}
 *   e.g. command bytes (hex):  01                    START
 *                              02                    STOP
 *                              03 05 00 00 00 02 00  RESEND seq 5 (4 bytes), count 2 (2 bytes) = 5 and 6
 *   Anything else -> error "not supported"; RESEND not exactly 7 bytes -> error "invalid length".
 * OUTPUT: 1 packet per Bluetooth message (layout: ehg_packet.h). Re-sent copies have flags bit0 = 1.
 *   e.g. 1st packet after START, 82 bytes (real tpehg1007 frames 0-9; checked with gateway/packet.py):
 *     header  02 | 03 | 14 00 | 00 00 00 00 | 00 00 00 00 | 00 80 01 00 | 0a | 00 | 00 00
 *             ver  n_ch fs=20  seq=0         frame_idx=0   t_inject=98304 10fr flags record_id=0
 *     samples 45 04 ab 00 14 fd | 79 04 b4 00 ea fc | ... (10 frames x 3 ch x 2 bytes)
 *             1093  171   -748  | 1145  180   -790  | ...
 *     crc     78 bb  (CRC-16 of the 80 bytes before it; recomputed when a resend sets the flag)
 *   e.g. the same header re-sent for seq 5: 02 03 14 00 05 00 00 00 32 00 00 00 00 c0 02 00 0a 01 00 00 ... de ff
 *     (frame_idx 50, t_inject 180224, flags 01 = re-sent)
 * HOW:
 *   1. Sets up a Bluetooth "service" with 2 slots: data (board -> laptop, pushed = "notify")
 *      and control (laptop -> board commands).
 *   2. tx_thread collects 10 frames (CONFIG_EHG_FRAMES_PER_PACKET), adds the 20-byte header, the CRC and the
 *      next packet number (seq), keeps a copy in history, sends.
 *   3. RESEND: finds the copy in history, sends it again with the "re-sent" flag.
 *   If the radio is busy, sending waits instead of dropping. The wait backs up into replay_ring,
 *   where any overflow is counted. So nothing is lost silently.
 * ROLE IN THESIS: Gantt 1c/1d. Batching = latency vs efficiency trade-off (H1).
 *   Numbering + history + resend = loss recovery (H2). Counters in the log show where loss happened.
 * BEFORE -> AFTER: Frames from replay.c. Connection from main.c. Packets -> gateway/gateway.py
 *   (decoded by gateway/packet.py), which sends RESEND back.
 * SEE: docs/firmware.md (overview + glossary), docs/interface-spec.md 3 (byte layout, commands).
  */
#include "ehg_service.h"

#include <string.h>
#include <zephyr/bluetooth/gatt.h>
#include <zephyr/bluetooth/uuid.h>
#include <zephyr/logging/log.h>
#include <zephyr/sys/byteorder.h>
#include <zephyr/sys/crc.h>

#include "ehg_packet.h"
#include "replay.h"

LOG_MODULE_REGISTER(ehg_svc, LOG_LEVEL_INF);

#define HDR_LEN sizeof(struct ehg_pkt_hdr)
BUILD_ASSERT(CONFIG_EHG_FRAMES_PER_PACKET <= UINT8_MAX);

static struct bt_uuid_128 svc_uuid = BT_UUID_INIT_128(EHG_UUID_BASE(1));
static struct bt_uuid_128 data_uuid = BT_UUID_INIT_128(EHG_UUID_BASE(2));
static struct bt_uuid_128 ctrl_uuid = BT_UUID_INIT_128(EHG_UUID_BASE(3));

/* A resend request from the laptop: "send packets seq .. seq+count-1 again". */
struct resend_req {
	uint32_t seq;
	uint16_t count;
};
K_MSGQ_DEFINE(resend_q, sizeof(struct resend_req), 16, 4);

/* History: copies of the last 256 sent packets (CONFIG_EHG_HISTORY_PACKETS), slot = seq mod 256.
 * Older ones get overwritten, so a very late resend request can't be served (counted as resend_miss). */
static struct hist_entry {
	uint32_t seq;
	bool valid;
	uint8_t len;
	uint8_t buf[EHG_MAX_PKT];
} history[CONFIG_EHG_HISTORY_PACKETS];

static struct bt_conn *conn;
static K_MUTEX_DEFINE(conn_lock);
static uint32_t n_sent, n_resent, n_resend_miss, n_notify_err, n_offline;

/* Fault injection settings (ehg_service_set_faults) and what they did. Off at boot. */
static struct {
	uint32_t rng; /* xorshift32 state: same seed = same faults, so a run can be repeated */
	uint16_t p_gb, p_bg, corrupt, disc_s;
	bool bad; /* Gilbert state: in a loss burst */
} flt;
static uint32_t n_inj_drop, n_inj_corrupt, n_inj_disc;

static uint32_t rnd(void)
{
	flt.rng ^= flt.rng << 13;
	flt.rng ^= flt.rng >> 17;
	flt.rng ^= flt.rng << 5;
	return flt.rng;
}

/* Forced disconnect, every disc_s seconds while enabled: tests reconnect + resend from history. */
static void disc_work_handler(struct k_work *work);
static K_WORK_DELAYABLE_DEFINE(disc_work, disc_work_handler);

static void disc_work_handler(struct k_work *work)
{
	if (flt.disc_s == 0) {
		return;
	}
	k_mutex_lock(&conn_lock, K_FOREVER);
	if (conn && bt_conn_disconnect(conn, BT_HCI_ERR_REMOTE_USER_TERM_CONN) == 0) {
		n_inj_disc++;
	}
	k_mutex_unlock(&conn_lock);
	k_work_reschedule(&disc_work, K_SECONDS(flt.disc_s));
}

void ehg_service_set_faults(uint32_t seed, uint16_t p_gb, uint16_t p_bg, uint16_t corrupt, uint16_t disc_s)
{
	flt.rng = seed ? seed : 1; /* xorshift must not start at 0 */
	flt.p_gb = p_gb;
	flt.p_bg = p_bg;
	flt.corrupt = corrupt;
	flt.disc_s = disc_s;
	flt.bad = false;
	n_inj_drop = n_inj_corrupt = n_inj_disc = 0;
	if (disc_s) {
		k_work_reschedule(&disc_work, K_SECONDS(disc_s));
	} else {
		k_work_cancel_delayable(&disc_work);
	}
	LOG_INF("faults: seed %u, good->bad %u/65536, bad->good %u/65536, corrupt %u/65536, disconnect every %u s",
		seed, p_gb, p_bg, corrupt, disc_s);
}

/* Runs when the laptop writes a command. Reads the 1-byte command code. RESEND is only queued
 * here; tx_thread does the sending, so this function returns quickly. */
static ssize_t ctrl_write(struct bt_conn *c, const struct bt_gatt_attr *attr, const void *buf,
			  uint16_t len, uint16_t offset, uint8_t flags)
{
	const uint8_t *b = buf;

	if (offset != 0 || len < 1) {
		return BT_GATT_ERR(BT_ATT_ERR_INVALID_ATTRIBUTE_LEN);
	}
	switch (b[0]) {
	case EHG_OP_START:
		replay_start();
		break;
	case EHG_OP_STOP:
		replay_stop();
		break;
	case EHG_OP_RESEND: {
		if (len != 7) {
			return BT_GATT_ERR(BT_ATT_ERR_INVALID_ATTRIBUTE_LEN);
		}
		struct resend_req r = {.seq = sys_get_le32(&b[1]), .count = sys_get_le16(&b[5])};

		if (k_msgq_put(&resend_q, &r, K_NO_WAIT) != 0) {
			n_resend_miss += r.count;
		}
		break;
	}
	default:
		return BT_GATT_ERR(BT_ATT_ERR_NOT_SUPPORTED);
	}
	return len;
}

/* Open by default; with CONFIG_EHG_REQUIRE_PAIRING the CCC (the subscribe switch) and the command slot need an
 * authenticated (passkey) link. _AUTHEN, not _ENCRYPT: _ENCRYPT alone can be met by Just Works pairing. The service and
 * characteristic declarations stay readable, so discovery works and the central only meets pairing on the first protected access. */
#ifdef CONFIG_EHG_REQUIRE_PAIRING
#define EHG_PERM_CCC (BT_GATT_PERM_READ_AUTHEN | BT_GATT_PERM_WRITE_AUTHEN)
#define EHG_PERM_CTRL BT_GATT_PERM_WRITE_AUTHEN
#else
#define EHG_PERM_CCC (BT_GATT_PERM_READ | BT_GATT_PERM_WRITE)
#define EHG_PERM_CTRL BT_GATT_PERM_WRITE
#endif

/* The service: data slot (board pushes) + its on/off switch the laptop sets (CCC) + command slot. */
BT_GATT_SERVICE_DEFINE(ehg_svc,
	BT_GATT_PRIMARY_SERVICE(&svc_uuid.uuid),
	BT_GATT_CHARACTERISTIC(&data_uuid.uuid, BT_GATT_CHRC_NOTIFY, BT_GATT_PERM_NONE, NULL, NULL, NULL),
	BT_GATT_CCC(NULL, EHG_PERM_CCC),
	BT_GATT_CHARACTERISTIC(&ctrl_uuid.uuid, BT_GATT_CHRC_WRITE | BT_GATT_CHRC_WRITE_WITHOUT_RESP,
			       EHG_PERM_CTRL, NULL, ctrl_write, NULL),
);

#define DATA_ATTR (&ehg_svc.attrs[2])

/* Remember the connection (or forget it when c is NULL). Losing it does NOT stop sampling: a real
 * sensor keeps measuring while the radio is down, so seq keeps counting and the gap is recovered
 * from history after the reconnect (up to CONFIG_EHG_HISTORY_PACKETS packets back). */
void ehg_service_set_conn(struct bt_conn *c)
{
	k_mutex_lock(&conn_lock, K_FOREVER);
	if (conn) {
		bt_conn_unref(conn);
	}
	conn = c ? bt_conn_ref(c) : NULL;
	k_mutex_unlock(&conn_lock);
}

bool ehg_service_connected(void)
{
	return conn != NULL;
}

/* Send 1 packet to the laptop, if connected and listening. Returns 0 on success. */
static int send(const uint8_t *buf, uint16_t len)
{
	int err = -ENOTCONN;

	k_mutex_lock(&conn_lock, K_FOREVER);
	struct bt_conn *c = conn ? bt_conn_ref(conn) : NULL;

	k_mutex_unlock(&conn_lock);
	if (!c) {
		return err;
	}
	/* Right after connecting, the max message size (MTU) may not be agreed yet: wait, don't drop. */
	for (int i = 0; i < 100 && bt_gatt_get_mtu(c) - 3 < len; i++) {
		k_sleep(K_MSEC(10));
	}
	if (bt_gatt_is_subscribed(c, DATA_ATTR, BT_GATT_CCC_NOTIFY)) {
		/* Fault stage (off unless tools/feed.py --faults): the Gilbert model decides whether this
		 * packet is "lost on the air" (not sent, but counted as sent, as a real loss looks to the
		 * board), else maybe one bit of the sent copy is flipped so the gateway's CRC must catch it. */
		if (flt.p_gb || flt.bad) {
			flt.bad = flt.bad ? (rnd() & 0xFFFF) >= flt.p_bg : (rnd() & 0xFFFF) < flt.p_gb;
		}
		if (flt.bad) {
			n_inj_drop++;
			err = 0;
		} else if (flt.corrupt && (rnd() & 0xFFFF) < flt.corrupt) {
			uint8_t tmp[EHG_MAX_PKT];
			uint32_t bit = rnd() % (len * 8);

			memcpy(tmp, buf, len);
			tmp[bit / 8] ^= BIT(bit % 8);
			n_inj_corrupt++;
			err = bt_gatt_notify(c, DATA_ATTR, tmp, len);
		} else {
			err = bt_gatt_notify(c, DATA_ATTR, buf, len); /* copies buf; waits if the radio is busy */
		}
	}
	bt_conn_unref(c);
	if (err) {
		n_notify_err++;
	}
	return err;
}

/* Write the CRC-16 trailer over everything before it. Called after any header change. */
static void put_crc(uint8_t *pkt, int len)
{
	sys_put_le16(crc16_itu_t(0xFFFF, pkt, len - EHG_CRC_BYTES), &pkt[len - EHG_CRC_BYTES]);
}

/* Handle queued RESEND requests: send each stored copy again with the "re-sent" flag. */
static void serve_resends(void)
{
	struct resend_req r;
	uint8_t tmp[EHG_MAX_PKT];

	while (k_msgq_get(&resend_q, &r, K_NO_WAIT) == 0) {
		for (uint32_t s = r.seq; s != r.seq + r.count; s++) {
			const struct hist_entry *h = &history[s % CONFIG_EHG_HISTORY_PACKETS];

			if (!h->valid || h->seq != s) {
				n_resend_miss++; /* already overwritten: the gateway logs it as lost */
				continue;
			}
			memcpy(tmp, h->buf, h->len);
			((struct ehg_pkt_hdr *)tmp)->flags |= EHG_FLAG_RETRANS;
			put_crc(tmp, h->len);
			if (send(tmp, h->len) == 0) {
				n_resent++;
			}
		}
	}
}

/* Close the packet being built: header frame count, CRC, copy into history, send, next seq. */
static void finish(uint8_t *pkt, uint8_t nf, int frame_bytes, uint32_t *seq)
{
	int len = HDR_LEN + nf * frame_bytes + EHG_CRC_BYTES;
	struct hist_entry *h = &history[*seq % CONFIG_EHG_HISTORY_PACKETS];

	((struct ehg_pkt_hdr *)pkt)->n_frames = nf;
	put_crc(pkt, len);
	h->seq = *seq;
	h->valid = true;
	h->len = len;
	memcpy(h->buf, pkt, len);
	int err = send(pkt, len);

	if (err == 0) {
		n_sent++;
	} else if (err == -ENOTCONN) {
		n_offline++; /* made while disconnected: kept in history for the resend after reconnect */
	}
	(*seq)++;
}

/* The packet builder. Loops forever: handle resends -> take 1 frame -> add it to the packet.
 * Full packet (up to CONFIG_EHG_FRAMES_PER_PACKET frames, fewer if many channels): finish it.
 * Only consecutive frames share a packet: a skipped frame (replay.c: starved) closes it early. */
static void tx_thread(void *a, void *b, void *c)
{
	uint8_t pkt[EHG_MAX_PKT];
	struct ehg_pkt_hdr *hdr = (struct ehg_pkt_hdr *)pkt;
	struct ehg_frame f;
	uint32_t seq = 0, next_idx = 0;
	uint8_t nf = 0, fpp = 1;
	int w = 2, frame_bytes = 0;

	for (;;) {
		serve_resends();
		if (k_msgq_get(&replay_ring, &f, K_MSEC(10)) != 0) {
			continue;
		}
		if (f.start) { /* new session: restart numbering, sizes from the record's CONFIG */
			seq = 0;
			nf = 0;
			memset(history, 0, sizeof(history));
			w = replay_bits() / 8;
			frame_bytes = replay_n_ch() * w;
			fpp = MIN(CONFIG_EHG_FRAMES_PER_PACKET,
				  (EHG_MAX_PKT - HDR_LEN - EHG_CRC_BYTES) / frame_bytes);
		} else if (nf > 0 && f.frame_idx != next_idx) {
			finish(pkt, nf, frame_bytes, &seq);
			nf = 0;
		}
		if (nf == 0) { /* 1st frame of a new packet: header takes its frame number + clock tick */
			*hdr = (struct ehg_pkt_hdr){
				.version = EHG_PKT_VERSION,
				.n_ch = replay_n_ch(),
				.fs_hz = replay_fs_hz(),
				.seq = seq,
				.frame_idx = f.frame_idx,
				.t_inject = f.tick,
				.flags = w == 3 ? EHG_FLAG_24BIT : 0,
				.record_id = replay_record_id(),
			};
		}
		uint8_t *dst = &pkt[HDR_LEN + nf * frame_bytes];

		for (int ch = 0; ch < replay_n_ch(); ch++, dst += w) {
			if (w == 3) {
				sys_put_le24((uint32_t)f.s[ch], dst);
			} else {
				sys_put_le16((uint16_t)f.s[ch], dst);
			}
		}
		next_idx = f.frame_idx + 1;
		if (++nf == fpp) {
			finish(pkt, nf, frame_bytes, &seq);
			nf = 0;
		}
	}
}

K_THREAD_DEFINE(tx_tid, 2048, tx_thread, NULL, NULL, NULL, 5, 0, 0);

/* Print counters to the serial log: sent, re-sent, resends too late, send errors,
 * packets made while disconnected (offline), frames dropped at the queue, frames the laptop did not deliver in time (starved) or delivered
 * too late (late), bad serial messages, worst frame lateness. */
void ehg_service_log_stats(void)
{
	LOG_INF("sent=%u offline=%u resent=%u resend_miss=%u notify_err=%u ring_overflow=%u starved=%u "
		"late=%u rx_bad=%u max_inject_late=%u us",
		n_sent, n_offline, n_resent, n_resend_miss, n_notify_err, replay_overflows(), replay_starved(),
		replay_late(), replay_rx_bad(), (uint32_t)k_ticks_to_us_ceil32(replay_max_late_ticks()));
	if (flt.p_gb || flt.corrupt || flt.disc_s) {
		LOG_INF("injected: drop=%u corrupt=%u disc=%u", n_inj_drop, n_inj_corrupt, n_inj_disc);
	}
}
```

## src/ehg_service.h
```c
/*
 * ehg_service.h - what other files may call in ehg_service.c, plus the Bluetooth service ID.
 *
 * PURPOSE: Declarations for ehg_service.c + the ID the laptop uses to find the EHG service.
 * HOW: A UUID = long unique number naming a Bluetooth "service" (a group of slots).
 *   Ours ends 0001; data slot 0002 (board -> laptop), command slot 0003 (laptop -> board).
 * ROLE IN THESIS: Gantt 1c/1d.
 * BEFORE -> AFTER: main.c calls these on connect/disconnect and advertises EHG_SVC_UUID_VAL.
 *   gateway/gateway.py has the same IDs as text. Commands: docs/interface-spec.md 3.
  */
#pragma once
#include <zephyr/bluetooth/conn.h>

/* Service 4e480001-a0e1-4c3b-8747-9a1b2c3d4e5f; data slot ...0002; command slot ...0003 */
#define EHG_UUID_BASE(n) BT_UUID_128_ENCODE(0x4e480000 + (n), 0xa0e1, 0x4c3b, 0x8747, 0x9a1b2c3d4e5f)
#define EHG_SVC_UUID_VAL EHG_UUID_BASE(1)

/* Set the current connection (NULL = disconnected; sampling and packet numbering continue). */
void ehg_service_set_conn(struct bt_conn *conn);

void ehg_service_log_stats(void);
bool ehg_service_connected(void); /* a laptop is connected (LED1 in main.c) */

/* Fault injection (tools/feed.py --faults, docs/fault-injection.md). Probabilities are out of 65536.
 * p_gb / p_bg: Gilbert model per packet, good->bad and bad->good (every packet in "bad" is dropped).
 * corrupt: chance one random bit of a sent copy is flipped (history keeps the clean copy).
 * disc_s: force a disconnect every disc_s seconds (0 = off). All 0 = off, the state at boot. */
void ehg_service_set_faults(uint32_t seed, uint16_t p_gb, uint16_t p_bg, uint16_t corrupt, uint16_t disc_s);
```

## src/replay.h
```c
/*
 * replay.h - what other files may call in replay.c (the fake sensor).
 *
 * PURPOSE: The list of replay.c functions other files can use: start/stop, read counters.
 * HOW: Declarations only. The code is in replay.c.
 * ROLE IN THESIS: "Digital injection" = playing a stored real EHG recording as if a sensor were
 *   measuring it live, so every result can be checked against a known answer.
 * BEFORE -> AFTER: Used by ehg_service.c (start/stop on laptop command, read frames from
 *   replay_ring, read counters for the log).
  */
#pragma once
#include <zephyr/kernel.h>

#include "ehg_packet.h"

/* Queue ("ring buffer") carrying frames from replay.c to ehg_service.c. */
extern struct k_msgq replay_ring;

void replay_start(void); /* start a session (no-op if running or before the laptop's CONFIG) */
void replay_stop(void);
bool replay_running(void); /* a session is sampling (LED2 in main.c) */

/* Frames dropped because the queue was full (sending fell behind). Counted, never silent. */
uint32_t replay_overflows(void);

/* Frames skipped because the laptop had not sent them by their due time (test-rig loss, not radio loss). */
uint32_t replay_starved(void);

/* Frames thrown away because they arrived after their due time had passed. */
uint32_t replay_late(void);

/* Serial messages rejected (bad COBS/CRC/length) or that did not fit the queue. */
uint32_t replay_rx_bad(void);

/* Worst lateness of any frame vs its exact due time, in clock ticks (timing jitter, Gantt 1d). */
uint32_t replay_max_late_ticks(void);

/* Record settings from the laptop's CONFIG (0 before it). */
uint8_t replay_n_ch(void);
uint8_t replay_bits(void);
uint16_t replay_fs_hz(void);
uint16_t replay_record_id(void);
```
